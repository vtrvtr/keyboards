/* config/corne.keymap — Corne (works for 36-key Mini: unused positions are &none) */

#include <behaviors.dtsi>
#include <dt-bindings/zmk/outputs.h>
#include <dt-bindings/zmk/keys.h>
#include <dt-bindings/zmk/bt.h>
#include <dt-bindings/zmk/rgb.h>

#pragma once

/* --------- your helper macros and defines from the Glove80 file --------- */
/* Paste EVERYTHING from your post starting at:
     // Helper Macros ... (ZMK_HELPER_STRINGIFY, VARGS, CONCAT, ZMK_TD_LAYER, etc.)
   through all of your:
     - behaviors { ... }  (HRMs, thumb_* behaviors, cappy, etc.)
     - macros   { ... }   (tild_a, circun_e, alttab, winleft/right/up/down, select_* ...)
     - combos   { ... }   (combo_special_e, combo_macmode, etc.)
   Keep layer #defines the same so your layer numbers still match.
*/

/* ---------- BEGIN: your pasted custom blocks ---------- */
/* 1) Helper macros / layer #defines / ZMK_TD_LAYER(lower, LAYER_Lower) */

/* 2) behaviors { ... } — include:
      - magic hold-tap
      - miryoku home-row mods (homey_left/right, shift_left/right)
      - thumb/lspace/rspace behaviors
      - cappy, caps_word override
*/

/* 3) combos { ... }  — your special letters + mode toggles */


/* 4) macros { ... }  — special letters, windowing, select_* macros, macsearch, macmissioncontrol */

/* ---------- END: your pasted custom blocks ---------- */

/ {
   keymap {
     compatible = "zmk,keymap";


    /* ┌────────────── LEFT ───────────────┐      ┌───────────── RIGHT ──────────────┐
       │  Q   W    E      R      T         │      │   Y     U      I     O     P   \ │
       │  A   S    D      F      G         │      │   H     J      K     L     ;   ' │
       │  Z   X    C      V      B         │      │   N     M      ,     .     /     │
       │               L1  L2   L3  │      │          R1  R2  R3                     │
       └───────────────────────────────────┘      └──────────────────────────────────┘

       L1 =  lspace 6 TAB      (hold = MO(6),  tap = TAB)
       L2 =  &caps_word
       L3 =  &alttab             (your macro)

       R1 =  thumb 5 ENTER     (hold = MO(5),  tap = ENTER)
       R2 =  rspace 5 SPACE    (hold = MO(5),  tap = SPACE)
       R3 =  &winbar            (your macro)
    */

    /* ---------- Base (your layer_Base) ---------- */

    layer_Base {
      bindings = <
        /* ───────────── Row 1 ───────────── */
           &kp Q                 &kp W                 &kp E                 &kp R                 &kp T
           &kp Y                 &kp U                 &kp I                 &kp O                 &kp P

        /* ───────────── Row 2 ───────────── */
           &homey_left LGUI A    &homey_left LCTRL S   &homey_left LALT D    &shift_left LSHFT F   &kp G
           &kp H                 &shift_right RSHFT J  &homey_right LALT K   &homey_right RCTRL L  &homey_right RGUI SEMI

        /* ───────────── Row 3 ───────────── */
           &kp Z                 &homey_left LC ( X ) X  &homey_left LC ( C ) C  &homey_left LC ( V ) V  &kp B
           &kp N                 &kp M                 &kp COMMA             &kp DOT               &mt LS(FSLH) FSLH

        /* ───────────── Thumbs (under B/N) ───────────── */
        &lspace 6 TAB          &caps_word             &alttab                &thumb 5 ENTER         &rspace 5 SPACE        &winbar
   };
 };
